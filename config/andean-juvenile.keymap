// -*- mode: dts; tab-width: 2; -*-

#include <behaviors.dtsi>
#include <dt-bindings/zmk/keys.h>
#include <dt-bindings/zmk/bt.h>
#define HOST_OS 2
#include "zmk-helpers/helper.h"
#include "unicode.h"

/*                                      48 KEY MATRIX / LAYOUT MAPPING

  ╭────────────────────┬─────────────────────╮   ╭─────────────────────┬─────────────────────╮
  │  0   1   2   3   4 │  5   6   7   8   9  │   │ LT4 LT3 LT2 LT1 LT0 │ RT0 RT1 RT2 RT3 RT4 │
  │ 10  11  12  13  14 │ 15  16  17  18  19  │   │ LM4 LM3 LM2 LM1 LM0 │ RM0 RM1 RM2 RM3 RM4 │
  │ 20  21  22  23  24 │ 25  26  27  28  29  │   │ LB4 LB3 LB2 LB1 LB0 │ RB0 RB1 RB2 RB3 RB4 │
  │         30  31  32 │ 33  34  35          │   │         LH2 LH1 LH0 │ RH0 RH1 RH2         │
  ╰────────────────────┴─────────────────────╯   ╰─────────────────────┴─────────────────────╯ */

// left-top row
#define LT0  4  
#define LT1  3
#define LT2  2
#define LT3  1
#define LT4  0

// right-top row
#define RT0  5  
#define RT1  6
#define RT2  7
#define RT3  8
#define RT4  9

// left-middle row
#define LM0 14  
#define LM1 13
#define LM2 12
#define LM3 11
#define LM4 10

// right-middle row
#define RM0 15  
#define RM1 16
#define RM2 17
#define RM3 18
#define RM4 19

// left-bottom row
#define LB0 24  
#define LB1 23
#define LB2 22
#define LB3 21
#define LB4 20

// right-bottom row
#define RB0 25  
#define RB1 26
#define RB2 27
#define RB3 28
#define RB4 29

// left thumb keys
#define LH0 32  
#define LH1 31
#define LH2 30

// right thumb keys
#define RH0 33  
#define RH1 34
#define RH2 35

#define KEYS_L LT0 LT1 LT2 LT3 LT4 LM0 LM1 LM2 LM3 LM4 LB0 LB1 LB2 LB3 LB4
#define KEYS_R RT0 RT1 RT2 RT3 RT4 RM0 RM1 RM2 RM3 RM4 RB0 RB1 RB2 RB3 RB4
#define THUMBS LH0 LH1 LH2 RH0 RH1 RH2 

// tap: sticky-shift | shift + tap/ double-tap: caps-word | hold: shift
ZMK_BEHAVIOR(smart_shft, mod_morph,
    bindings = <&sk LSHFT>, <&caps_word>;
    mods = <(MOD_LSFT)>;
)
&caps_word {  // mods deactivate caps-word, requires PR #1451
    /delete-property/ ignore-modifiers;
};

// reuse basic mod-morph scheme
#define SIMPLE_MORPH(NAME, MOD, BINDING1, BINDING2) \
    ZMK_MOD_MORPH(NAME, \
        mods = <(MOD_L ## MOD|MOD_R ## MOD)>; \
        bindings = <BINDING1>, <BINDING2>; \
    )

// tap: colon | shift + tap: semicolon
SIMPLE_MORPH(colonsemi, SFT, &kp COLON, &kp SEMI)

#define QUICK_TAP_MS 175

#define MAKE_HRM(NAME, HOLD, TAP, TRIGGER_POS) \
    ZMK_HOLD_TAP(NAME, \
        flavor = "balanced"; \
        tapping-term-ms = <280>; \
        quick-tap-ms = <QUICK_TAP_MS>; \
        require-prior-idle-ms = <150>; \
        bindings = <HOLD>, <TAP>; \
        hold-trigger-key-positions = <TRIGGER_POS>; \
        hold-trigger-on-release; \
)

MAKE_HRM(hml, &kp, &kp, KEYS_R THUMBS)  // left-hand HRMs
MAKE_HRM(hmr, &kp, &kp, KEYS_L THUMBS)  // right-hand HRMs

ZMK_HOLD_TAP(hmlslow, 
    flavor = "balanced"; 
    tapping-term-ms = <280>; 
    quick-tap-ms = <280>; 
    require-prior-idle-ms = <150>; 
    bindings = <&kp>, <&kp>; 
    hold-trigger-key-positions = <KEYS_R THUMBS>; 
    hold-trigger-on-release; 
)

MAKE_HRM(hltl, &mo, &kp, KEYS_R THUMBS)  // left-hand HR layer-taps
MAKE_HRM(hltr, &mo, &kp, KEYS_L THUMBS)  // right-hand HR layer-taps

//MAKE_HRM(hml_repeat, &kp, &key_repeat, KEYS_R THUMBS)  // used for HRM-combo
//MAKE_HRM(hmr_lpar_lt, &kp, &lpar_lt, KEYS_L THUMBS)    // "    "   "   "
//MAKE_HRM(hmr_rpar_gt, &kp, &rpar_gt, KEYS_L THUMBS)    // "    "   "   "

// tap: nothing | hold: symbol layer | cmd + hold: new layer
ZMK_MOD_MORPH(sym_layer6,
    bindings = <&mo 2>, <&mo 6>;
    mods = <(MOD_LGUI|MOD_RGUI)>;
)

ZMK_BEHAVIOR(flip_buffer, macro,
    wait-ms = <100>;
    tap-ms = <5>;
    bindings = <&kp LC(X) &kp B &kp RET>;
)

ZMK_BEHAVIOR(clear_shell, macro,
    wait-ms = <100>;
    tap-ms = <5>;
    bindings = <&kp LC(C) &kp LG(O)>;
)

#include "andean-juvenile-layout.h"


