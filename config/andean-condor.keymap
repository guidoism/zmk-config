/*                                      48 KEY MATRIX / LAYOUT MAPPING

  ╭────────────────────────┬────────────────────────╮ ╭─────────────────────────┬─────────────────────────╮
  │  0   1   2   3   4   5 │  6   7   8   9  10  11 │ │ LT5 LT4 LT3 LT2 LT1 LT0 │ RT0 RT1 RT2 RT3 RT4 RT5 │
  │ 12  13  14  15  16  17 │ 18  19  20  21  22  23 │ │ LM5 LM4 LM3 LM2 LM1 LM0 │ RM0 RM1 RM2 RM3 RM4 RM5 │
  │ 24  25  26  27  28  29 │ 30  31  32  33  34  35 │ │ LB5 LB4 LB3 LB2 LB1 LB0 │ RB0 RB1 RB2 RB3 RB4 RB5 │
  │                 36  37 │ 38  39                 │ │                 LH5 LH4 │ RH4 RH5                 │
  │         40  41  42  43 │ 44  45  46  47         │ │         LH3 LH2 LH1 LH0 │ RH0 RH1 RH2 RH3         │
  ╰────────────────────────┴────────────────────────╯ ╰─────────────────────────┴─────────────────────────╯ */

#define LT0  5  // left-top row
#define LT1  4
#define LT2  3
#define LT3  2
#define LT4  1
#define LT5  0

#define RT0  6  // right-top row
#define RT1  7
#define RT2  8
#define RT3  9
#define RT4 10
#define RT5 11

#define LM0 17  // left-middle row
#define LM1 16
#define LM2 15
#define LM3 14
#define LM4 13
#define LM5 12

#define RM0 18  // right-middle row
#define RM1 19
#define RM2 20
#define RM3 21
#define RM4 22
#define RM5 23

#define LB0 29  // left-bottom row
#define LB1 28
#define LB2 27
#define LB3 26
#define LB4 25
#define LB5 24

#define RB0 30  // right-bottom row
#define RB1 31
#define RB2 32
#define RB3 33
#define RB4 34
#define RB5 35

#define LH0 43  // left thumb keys
#define LH1 42
#define LH2 41
#define LH3 40
#define LH4 37
#define LH5 36

#define RH0 44  // right thumb keys
#define RH1 45
#define RH2 46
#define RH3 47
#define RH4 38
#define RH5 39

// -*- mode: dts; tab-width: 2; -*-
#include <behaviors.dtsi>
#include <dt-bindings/zmk/keys.h>
#include <dt-bindings/zmk/bt.h>
#include <dt-bindings/zmk/rgb.h>
#define HOST_OS 2
#include "zmk-helpers/helper.h"

// urob/zmk-helpers removed `#define ALL 0xff` on 2026-04-20 (PR #106). Re-add
// it locally so our existing 5-arg ZMK_COMBO(... ALL ...) calls keep working.
#define ALL 0xff

ZMK_UNICODE_SINGLE(euro_sign,                 N2, N0,  A,  C)   // €  EURO SIGN
ZMK_UNICODE_SINGLE(degree_symbol,             N0, N0,  B, N0)   // °  DEGREE SIGN
ZMK_UNICODE_SINGLE(prime,                     N2, N0, N3, N2)   // ′  PRIME
ZMK_UNICODE_SINGLE(double_prime,              N2, N0, N3, N3)   // ″  DOUBLE PRIME
ZMK_UNICODE_SINGLE(en_dash,                   N2, N0, N1, N3)   // –  EN DASH
ZMK_UNICODE_SINGLE(em_dash,                   N2, N0, N1, N4)   // —  EM DASH
ZMK_UNICODE_SINGLE(triangular_bullet,         N2, N0, N2, N3)   // ‣  TRIANGULAR BULLET
ZMK_UNICODE_SINGLE(left_single_quote,         N2, N0, N1, N8)   // ‘  LEFT SINGLE QUOTATION MARK
ZMK_UNICODE_SINGLE(right_single_quote,        N2, N0, N1, N9)   // ’  RIGHT SINGLE QUOTATION MARK
ZMK_UNICODE_SINGLE(left_double_quote,         N2, N0, N1,  C)   // “  LEFT DOUBLE QUOTATION MARK
ZMK_UNICODE_SINGLE(right_double_quote,        N2, N0, N1,  D)   // ”  RIGHT DOUBLE QUOTATION MARK
ZMK_UNICODE_SINGLE(multiplication_sign,       N0, N0,  D, N7)   // ×  MULTIPLICATION SIGN
ZMK_UNICODE_SINGLE(division_sign,             N0, N0,  F, N7)   // ÷  DIVISION SIGN
ZMK_UNICODE_SINGLE(for_all,                   N2, N2, N0, N0)   // ∀  FOR ALL
ZMK_UNICODE_SINGLE(there_exists,              N2, N2, N0, N3)   // ∃  THERE EXISTS
ZMK_UNICODE_SINGLE(empty_set,                 N2, N2, N0, N5)   // ∅  EMPTY SET
ZMK_UNICODE_SINGLE(element_of,                N2, N2, N0, N8)   // ∈  ELEMENT OF
ZMK_UNICODE_SINGLE(qed_motherfucker,          N2, N2, N0,  E)   // ∎  END OF PROOF
ZMK_UNICODE_SINGLE(product,                   N2, N2, N0,  F)   // ∏  N-ARY PRODUCT
ZMK_UNICODE_SINGLE(sum,                       N2, N2, N1, N1)   // ∑  N-ARY SUMMATION
ZMK_UNICODE_SINGLE(ring,                      N2, N2, N1, N8)   // ∘  RING OPERATOR
ZMK_UNICODE_SINGLE(proportional,              N2, N2, N1,  D)   // ∝  PROPORTIONAL TO
ZMK_UNICODE_SINGLE(infinity,                  N2, N2, N1,  E)   // ∞  INFINITY
ZMK_UNICODE_SINGLE(logical_and,               N2, N2, N2, N7)   // ∧  LOGICAL AND
ZMK_UNICODE_SINGLE(logical_or,                N2, N2, N2, N8)   // ∨  LOGICAL OR
ZMK_UNICODE_SINGLE(intersection,              N2, N2, N2, N9)   // ∩  INTERSECTION
ZMK_UNICODE_SINGLE(union,                     N2, N2, N2,  A)   // ∪  UNION
ZMK_UNICODE_SINGLE(almost_equal,              N2, N2, N4, N8)   // ≈  ALMOST EQUAL TO
ZMK_UNICODE_SINGLE(less_than_or_equal,        N2, N2, N6, N4)   // ≤  LESS-THAN OR EQUAL TO
ZMK_UNICODE_SINGLE(greater_than_or_equal,     N2, N2, N6, N5)   // ≥  GREATER-THAN OR EQUAL TO
ZMK_UNICODE_SINGLE(identical_to,              N2, N2, N6, N1)   // ≡  IDENTICAL TO
ZMK_UNICODE_SINGLE(box_upperleft,             N2, N5, N6,  D)   // ╭  BOX DRAWINGS LIGHT ARC DOWN AND RIGHT
ZMK_UNICODE_SINGLE(box_upperright,            N2, N5, N6,  E)   // ╮  BOX DRAWINGS LIGHT ARC DOWN AND LEFT
ZMK_UNICODE_SINGLE(box_lowerright,            N2, N5, N6,  F)   // ╯  BOX DRAWINGS LIGHT ARC UP AND LEFT
ZMK_UNICODE_SINGLE(box_lowerleft,             N2, N5, N7, N0)   // ╰  BOX DRAWINGS LIGHT ARC UP AND RIGHT
ZMK_UNICODE_SINGLE(box_horizontal,            N2, N5, N0, N0)   // ─  BOX DRAWINGS LIGHT HORIZONTAL
ZMK_UNICODE_SINGLE(box_vertical,              N2, N5, N0, N2)   // │  BOX DRAWINGS LIGHT VERTICAL
ZMK_UNICODE_SINGLE(box_middle,                N2, N5, N3,  C)   // ┼  BOX DRAWINGS LIGHT VERTICAL AND HORIZONTAL
ZMK_UNICODE_SINGLE(box_middlebottom,          N2, N5, N3, N4)   // ┴  BOX DRAWINGS LIGHT UP AND HORIZONTAL
ZMK_UNICODE_SINGLE(box_middletop,             N2, N5, N2,  C)   // ┬  BOX DRAWINGS LIGHT DOWN AND HORIZONTAL
ZMK_UNICODE_SINGLE(box_middleright,           N2, N5, N2, N4)   // ┤  BOX DRAWINGS LIGHT VERTICAL AND LEFT
ZMK_UNICODE_SINGLE(box_middleleft,            N2, N5, N1,  C)   // ├  BOX DRAWINGS LIGHT VERTICAL AND RIGHT
ZMK_UNICODE_SINGLE(ohm,                       N0, N3,  A, N9)   // Ω  GREEK CAPITAL LETTER OMEGA
ZMK_UNICODE_SINGLE(micro,                     N0, N0,  B, N5)   // µ  MICRO SIGN
ZMK_UNICODE_SINGLE(superscript_2,             N0, N0,  B, N2)   // ²  SUPERSCRIPT TWO
ZMK_UNICODE_SINGLE(superscript_3,             N0, N0,  B, N3)   // ³  SUPERSCRIPT THREE
ZMK_UNICODE_SINGLE(accented_a,                N0, N0,  E, N1)   // á  LATIN SMALL LETTER A WITH ACUTE
ZMK_UNICODE_SINGLE(accented_e,                N0, N0,  E, N9)   // é  LATIN SMALL LETTER E WITH ACUTE
ZMK_UNICODE_SINGLE(accented_i,                N0, N0,  E,  D)   // í  LATIN SMALL LETTER I WITH ACUTE
ZMK_UNICODE_SINGLE(tilde_n,                   N0, N0,  F, N1)   // ñ  LATIN SMALL LETTER N WITH TILDE
ZMK_UNICODE_SINGLE(accented_o,                N0, N0,  F, N3)   // ó  LATIN SMALL LETTER O WITH ACUTE
ZMK_UNICODE_SINGLE(accented_u,                N0, N0,  F,  A)   // ú  LATIN SMALL LETTER U WITH ACUTE
ZMK_UNICODE_SINGLE(umlat,                     N0, N0,  F,  C)   // ü  LATIN SMALL LETTER U WITH DIAERESIS
ZMK_UNICODE_SINGLE(upsidedown_question,       N0, N0,  B,  F)   // ¿  INVERTED QUESTION MARK
ZMK_UNICODE_SINGLE(upsidedown_bang,           N0, N0,  A, N1)   // ¡  INVERTED EXCLAMATION MARK
ZMK_UNICODE_SINGLE(cent_sign,                 N0, N0,  A, N2)   // ¢  CENT SIGN
ZMK_UNICODE_SINGLE(pound_sign,                N0, N0,  A, N3)   // £  POUND SIGN
ZMK_UNICODE_SINGLE(section_sign,              N0, N0,  A, N7)   // §  SECTION SIGN
ZMK_UNICODE_SINGLE(pilcrow,                   N0, N0,  B, N6)   // ¶  PILCROW SIGN
ZMK_UNICODE_SINGLE(left_arrow,                N2, N1, N9, N0)   // ←  LEFTWARDS ARROW
ZMK_UNICODE_SINGLE(right_arrow,               N2, N1, N9, N2)   // →  RIGHTWARDS ARROW
ZMK_UNICODE_SINGLE(up_arrow,                  N2, N1, N9, N1)   // ↑  UPWARDS ARROW
ZMK_UNICODE_SINGLE(down_arrow,                N2, N1, N9, N3)   // ↓  DOWNWARDS ARROW
ZMK_UNICODE_SINGLE(left_right_arrow,          N2, N1, N9, N4)   // ↔  LEFT RIGHT ARROW
ZMK_UNICODE_SINGLE(up_down_arrow,             N2, N1, N9, N5)   // ↕  UP DOWN ARROW


#define KEYS_L LT0 LT1 LT2 LT3 LT4 LT5 LM0 LM1 LM2 LM3 LM4 LM5 LB0 LB1 LB2 LB3 LB4 LB5
#define KEYS_R RT0 RT1 RT2 RT3 RT4 RT5 RM0 RM1 RM2 RM3 RM4 RM5 RB0 RB1 RB2 RB3 RB4 RB5
#define THUMBS LH0 LH1 LH2 LH3 LH4 LH5 RH0 RH1 RH2 RH3 RH4 RH5

// tap: sticky-shift | shift + tap/ double-tap: caps-word | hold: shift
ZMK_BEHAVIOR(smart_shft, mod_morph,
    bindings = <&sk LSHFT>, <&caps_word>;
    mods = <(MOD_LSFT)>;
)
&caps_word {  // mods deactivate caps-word, requires PR #1451
    /delete-property/ ignore-modifiers;
};

// reuse basic mod-morph scheme
#define SIMPLE_MORPH(NAME, MOD, BINDING1, BINDING2) \
    ZMK_MOD_MORPH(NAME, \
        mods = <(MOD_L ## MOD|MOD_R ## MOD)>; \
        bindings = <BINDING1>, <BINDING2>; \
    )

// tap: colon | shift + tap: semicolon
SIMPLE_MORPH(colonsemi, SFT, &kp COLON, &kp SEMI)

#define QUICK_TAP_MS 175

#define MAKE_HRM(NAME, HOLD, TAP, TRIGGER_POS) \
    ZMK_HOLD_TAP(NAME, \
        flavor = "balanced"; \
        tapping-term-ms = <280>; \
        quick-tap-ms = <QUICK_TAP_MS>; \
        require-prior-idle-ms = <150>; \
        bindings = <HOLD>, <TAP>; \
        hold-trigger-key-positions = <TRIGGER_POS>; \
        hold-trigger-on-release; \
    )
MAKE_HRM(hml, &kp, &kp, KEYS_R THUMBS)  // left-hand HRMs
MAKE_HRM(hmr, &kp, &kp, KEYS_L THUMBS)  // right-hand HRMs

ZMK_HOLD_TAP(hmlslow, 
    flavor = "balanced"; 
    tapping-term-ms = <280>; 
    quick-tap-ms = <280>; 
    require-prior-idle-ms = <150>; 
    bindings = <&kp>, <&kp>; 
    hold-trigger-key-positions = <KEYS_R THUMBS>; 
    hold-trigger-on-release; 
)

MAKE_HRM(hltl, &mo, &kp, KEYS_R THUMBS)  // left-hand HR layer-taps
MAKE_HRM(hltr, &mo, &kp, KEYS_L THUMBS)  // right-hand HR layer-taps

//MAKE_HRM(hml_repeat, &kp, &key_repeat, KEYS_R THUMBS)  // used for HRM-combo
//MAKE_HRM(hmr_lpar_lt, &kp, &lpar_lt, KEYS_L THUMBS)    // "    "   "   "
//MAKE_HRM(hmr_rpar_gt, &kp, &rpar_gt, KEYS_L THUMBS)    // "    "   "   "

// tap: nothing | hold: symbol layer | cmd + hold: new layer
ZMK_MOD_MORPH(sym_layer6,
    bindings = <&mo 2>, <&mo 6>;
    mods = <(MOD_LGUI|MOD_RGUI)>;
)

ZMK_BEHAVIOR(flip_buffer, macro,
    wait-ms = <100>;
    tap-ms = <5>;
    bindings = <&kp LC(X) &kp B &kp RET>;
)

ZMK_BEHAVIOR(clear_shell, macro,
    wait-ms = <100>;
    tap-ms = <5>;
    bindings = <&kp LC(C) &kp LG(O)>;
)

ZMK_BEHAVIOR(ispell_word, macro,
    wait-ms = <100>;
    tap-ms = <5>;
    bindings = <&kp LC(C) &kp I>;
)

// index on r u in FN layer within 100 milliseconds
ZMK_COMBO(startbootloader,  &bootloader, 4 7, 9, 100)

//////////////////////////////////////////////////////////
// L E F T   H A N D

// TAB = S + F
ZMK_COMBO(tab_combo, &kp TAB, 14 16, ALL, 50)

// MOV = D + F
ZMK_COMBO(mov_combo, &mo 3, 15 16, ALL, 50)

// OPT = R + T
ZMK_COMBO(option_combo, &kp LALT, 4 5, ALL, 50)

//////////////////////////////////////////////////////////
// R I G H T   H A N D 

// RET = J + L
ZMK_COMBO(ret_combo, &kp RET, 19 21, ALL, 50)

// SFT = J + K
ZMK_COMBO(oneshot_shift_combo, &sk LSHIFT, 19 20, ALL, 50)

// CAPSWORD = J + K + L
ZMK_COMBO(capsword_combo, &caps_word, 19 20 21, ALL, 50)

// Bluetooth 
ZMK_COMBO(bt_sel_combo, &mo 6, 38 39, ALL, 50)

//////////////////////////////////////////////////////////
// L A Y E R   I N D I C A T O R   L E D
// Uses KB2040 onboard NeoPixel via zmk-listeners
// Green = default, colors below on layer activate, green on deactivate

#define LED_BRT 10
#define LED_GREEN RGB_COLOR_HSB(120,100,LED_BRT)
#define LED_RED   RGB_COLOR_HSB(0,100,LED_BRT)
#define LED_BLUE  RGB_COLOR_HSB(240,100,LED_BRT)
#define LED_YELLOW RGB_COLOR_HSB(60,100,LED_BRT)
#define LED_MAGENTA RGB_COLOR_HSB(300,100,LED_BRT)
#define LED_CYAN  RGB_COLOR_HSB(180,100,LED_BRT)
#define LED_WHITE RGB_COLOR_HSB(0,0,LED_BRT)

/ {
    layer_listeners {
        compatible = "zmk,layer-listeners";
        ll_numsym {
            layers = <1>;
            bindings = <&rgb_ug LED_RED &rgb_ug LED_GREEN>;
        };
        ll_brackets {
            layers = <2>;
            bindings = <&rgb_ug LED_CYAN &rgb_ug LED_GREEN>;
        };
        ll_hci {
            layers = <3>;
            bindings = <&rgb_ug LED_BLUE &rgb_ug LED_GREEN>;
        };
        ll_winmgmt {
            layers = <4>;
            bindings = <&rgb_ug LED_BLUE &rgb_ug LED_GREEN>;
        };
        ll_spanish {
            layers = <5>;
            bindings = <&rgb_ug LED_YELLOW &rgb_ug LED_GREEN>;
        };
        ll_special {
            layers = <6>;
            bindings = <&rgb_ug LED_MAGENTA &rgb_ug LED_GREEN>;
        };
        ll_gaming {
            layers = <7>;
            bindings = <&rgb_ug LED_RED &rgb_ug LED_GREEN>;
        };
        ll_boxdraw {
            layers = <8>;
            bindings = <&rgb_ug LED_WHITE &rgb_ug LED_GREEN>;
        };
        ll_fkeys {
            layers = <9>;
            bindings = <&rgb_ug LED_MAGENTA &rgb_ug LED_GREEN>;
        };
    };
};

ZMK_LAYER(layer_0, &kp TAB &kp Q &kp W &kp E &kp R &kp T &kp Y &kp U &kp I &kp O &kp P &kp BSPC &kp LCTRL &kp A &kp S &kp D &kp F &kp G &kp H &hmr RCTRL J &kp K &kp L &colonsemi &kp RET &smart_shft &kp Z &kp X &kp C &kp V &kp B &kp N &kp M &kp COMMA &kp DOT &kp SLASH &none &smart_shft &none &none &tog 8 &mo 4 &kp LCMD &mo 1 &mo 3 &mo 5 &hmr RSHIFT SPACE &sym_layer6 &none)
ZMK_LAYER(layer_1, &kp TILDE &kp EXCL &kp AT &kp HASH &kp DLLR &kp PERCENT &kp CARET &kp N7 &kp N8 &kp N9 &degree_symbol &kp BSPC &superscript_2 &kp DQT &kp AMPS &kp STAR &kp UNDER &kp N0 &kp PLUS &kp N4 &kp N5 &kp N6 &kp SQT &kp PIPE &superscript_3 &multiplication_sign &division_sign &kp EQUAL &kp MINUS &kp DOT &none &kp N1 &kp N2 &kp N3 &kp SLASH &none &none &none &none &none &none &kp LCMD &trans &none &none &hmr RSHIFT SPACE &none &none)
ZMK_LAYER(layer_2, &none &left_double_quote &right_double_quote &left_single_quote &right_single_quote &double_prime &micro &ohm &none &en_dash &none &kp BSPC &none &kp LBKT &kp RBKT &kp LPAR &kp RPAR &prime &kp TILDE &kp MINUS &kp EQUAL &em_dash &kp PIPE &kp BACKSLASH &none &kp LT &kp GT &kp LBRC &kp RBRC &kp GRAVE &none &none &none &none &kp BACKSLASH &none &none &none &none &none &none &mo 9 &none &none &none &hmr RSHIFT SPACE &trans &none)
ZMK_LAYER(layer_3, &kp ESC &none &none &kp LG(LBRC) &kp LG(RBRC) &none &kp ESC &kp PGUP &kp UP &kp PGDN &none &none &none &none &none &kp LG(B) &kp LG(F) &ispell_word &kp BSPC &kp LEFT &kp DOWN &kp RIGHT &kp LG(M) &none &none &none &none &none &none &none &kp DEL &kp HOME &none &kp END &none &none &none &none &none &none &none &kp LCMD &none &trans &none &hmr RSHIFT SPACE &none &none)
ZMK_LAYER(layer_4, &none &none &none &none &none &none &none &none &none &none &none &none &none &none &none &none &none &none &none &none &none &none &none &none &none &none &none &none &kp LC(LS(LA(V))) &none &none &none &none &none &none &none &none &none &none &none &none &kp LCMD &trans &trans &none &hmr RSHIFT SPACE &none &none)
ZMK_LAYER(layer_5, &none &none &umlat &accented_e &none &none &none &accented_u &accented_i &accented_o &pound_sign &none &none &accented_a &section_sign &euro_sign &none &none &none &none &none &none &none &none &none &none &pilcrow &cent_sign &none &none &tilde_n &none &none &upsidedown_bang &upsidedown_question &none &none &none &none &none &none &none &none &none &none &none &none &none)
ZMK_LAYER(layer_6, &bt BT_SEL 0 &none &none &none &none &none &none &none &none &none &bootloader &none &bt BT_SEL 1 &none &none &none &tog 7 &none &none &none &none &none &none &none &bt BT_SEL 2 &none &none &none &none &none &none &none &none &none &none &none &none &none &none &none &none &none &none &none &none &none &none &none)
ZMK_LAYER(layer_7, &tog 7 &kp Q &none &kp W &kp E &none &none &none &none &none &none &none &none &kp LCTRL &kp A &kp S &kp D &kp F &none &none &none &none &none &kp RET &none &none &kp N3 &kp N2 &kp N1 &none &none &none &none &none &kp SLASH &none &none &none &none &none &none &smart_shft &kp SPACE &kp ESC &none &none &none &none)
ZMK_LAYER(layer_8, &none &none &none &box_upperleft &box_upperright &none &none &none &left_right_arrow &up_arrow &up_down_arrow &none &none &box_horizontal &box_vertical &box_lowerleft &box_lowerright &none &tog 8 &none &left_arrow &down_arrow &right_arrow &none &none &box_middle &box_middlebottom &box_middletop &box_middleright &box_middleleft &none &none &none &none &none &none &none &none &none &none &none &kp LCMD &none &none &none &none &none &none)
ZMK_LAYER(layer_9, &none &kp ESC &kp F1 &kp F2 &kp F3 &kp F4 &kp F5 &kp F6 &kp F7 &kp F8 &kp F9 &none &none &none &flip_buffer &kp LC(LG(N0)) &kp LC(LG(N1)) &none &clear_shell &kp LC(LG(N2)) &kp LC(LG(N3)) &kp LG(O) &kp LS(LA(LC(Q))) &none &none &kp F10 &kp F11 &kp F12 &kp F13 &kp F14 &kp F15 &kp F16 &kp F17 &kp F18 &kp LG(LS(N4)) &none &none &none &none &none &none &trans &none &none &none &none &trans &none)
