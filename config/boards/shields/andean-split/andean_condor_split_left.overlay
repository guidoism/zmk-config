#include "andean_condor_split.dtsi" // Notice that the main dtsi files are included in the overlay.

&kscan0 {
    col-gpios
        = <&pro_micro 21 GPIO_ACTIVE_HIGH> // col0 in ergogen
        , <&pro_micro 20 GPIO_ACTIVE_HIGH> // col1 in ergogen
        , <&pro_micro 19 GPIO_ACTIVE_HIGH> // col2 in ergogen
        , <&pro_micro 18 GPIO_ACTIVE_HIGH> // col3 in ergogen
        , <&pro_micro 15 GPIO_ACTIVE_HIGH> // col4 in ergogen
        , <&pro_micro 14 GPIO_ACTIVE_HIGH> // col5 in ergogen
        ;
};
