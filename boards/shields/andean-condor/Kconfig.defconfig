## boards/shields/andean-condor/Kconfig.defconfig
```kconfig
# Copyright (c) 2023 The ZMK Contributors
# SPDX-License-Identifier: MIT

if SHIELD_ANDEAN_CONDOR

config ZMK_KEYBOARD_NAME
    default "Andean Condor"

endif
```

## boards/shields/andean-condor/Kconfig.shield
```kconfig
# Copyright (c) 2023 The ZMK Contributors
# SPDX-License-Identifier: MIT

config SHIELD_ANDEAN_CONDOR
    def_bool $(shields_list_contains,andean-condor)
    
```

## boards/shields/andean-juvenile/Kconfig.shield
```kconfig
# Copyright (c) 2023 The ZMK Contributors
# SPDX-License-Identifier: MIT

config SHIELD_ANDEAN_JUVENILE
    def_bool $(shields_list_contains,andean-juvenile)
    
```

## config/boards/shields/andean-condor-split/Kconfig.shield
```kconfig
config SHIELD_ANDEAN_CONDOR_SPLIT_LEFT
    def_bool $(shields_list_contains,andean_condor_split_left)

config SHIELD_ANDEAN_CONDOR_SPLIT_RIGHT
    def_bool $(shields_list_contains,andean_condor_split_right)
```

## config/boards/shields/andean-juvenile/Kconfig.defconfig
```kconfig
# Copyright (c) 2023 The ZMK Contributors
# SPDX-License-Identifier: MIT

if SHIELD_ANDEAN_JUVENILE

config ZMK_KEYBOARD_NAME
    default "Andean Condor Juvenile"

endif
```

## config/west.yml
```yaml
manifest:
  remotes:
    - name: zmkfirmware
      url-base: https://github.com/zmkfirmware
    - name: guidoism
      url-base: https://github.com/guidoism
    - name: urob
      url-base: https://github.com/urob
    - name: ssbb
      url-base: https://github.com/ssbb
    - name: zzeneg
      url-base: https://github.com/zzeneg
  projects:
    - name: zmk
      remote: guidoism # zmkfirmware
      revision: feature/raw-hid-status # main
      import: app/west.yml
    - name: zmk-helpers
      remote: urob
      revision: main
    - name: zmk-listeners
      remote: ssbb
      revision: v1
    - name: zmk-raw-hid
      remote: zzeneg
      revision: main
  self:
    path: config
```
