/*
 * nice_nano on v1.1 PCB:
 *   - MCU mounted components-down (back facing up, standard nice!nano mount)
 *   - Pin mapping matches original KB2040 orientation (no mirroring needed)
 *   - Diodes are row2col (anode on row, cathode on col/switch side)
 *
 * Override diode direction only; pin assignments match the shared overlay.
 */

&kscan0 {
    diode-direction = "row2col";

    /* Same pins as shared overlay, but with swapped flags for row2col:
     * cols are now inputs (readers), rows are outputs (drivers) */
    col-gpios
        = <&pro_micro 15 (GPIO_ACTIVE_HIGH | GPIO_PULL_DOWN)>
        , <&pro_micro  7 (GPIO_ACTIVE_HIGH | GPIO_PULL_DOWN)>
        , <&pro_micro  6 (GPIO_ACTIVE_HIGH | GPIO_PULL_DOWN)>
        , <&pro_micro  4 (GPIO_ACTIVE_HIGH | GPIO_PULL_DOWN)>
        , <&pro_micro  5 (GPIO_ACTIVE_HIGH | GPIO_PULL_DOWN)>
        , <&pro_micro 14 (GPIO_ACTIVE_HIGH | GPIO_PULL_DOWN)>
        ;

    row-gpios
        = <&pro_micro 19 GPIO_ACTIVE_HIGH>
        , <&pro_micro 18 GPIO_ACTIVE_HIGH>
        , <&pro_micro  8 GPIO_ACTIVE_HIGH>
        , <&pro_micro  9 GPIO_ACTIVE_HIGH>
        , <&pro_micro 21 GPIO_ACTIVE_HIGH>
        , <&pro_micro 20 GPIO_ACTIVE_HIGH>
        , <&pro_micro 16 GPIO_ACTIVE_HIGH>
        , <&pro_micro 10 GPIO_ACTIVE_HIGH>
        ;
};

/* v1.1 PCB has thumb keys at col4/col6 positions swapped vs original.
 * Override matrix transform to match physical layout. */
&default_transform {
    map = <
        RC(0,0) RC(0,1) RC(0,2) RC(0,3) RC(0,4) RC(0,5)   RC(4,5) RC(4,4) RC(4,3) RC(4,2) RC(4,1) RC(4,0)
        RC(1,0) RC(1,1) RC(1,2) RC(1,3) RC(1,4) RC(1,5)   RC(5,5) RC(5,4) RC(5,3) RC(5,2) RC(5,1) RC(5,0)
        RC(2,0) RC(2,1) RC(2,2) RC(2,3) RC(2,4) RC(2,5)   RC(6,5) RC(6,4) RC(6,3) RC(6,2) RC(6,1) RC(6,0)
                                        RC(3,3) RC(3,4)   RC(7,4) RC(7,3)
                        RC(3,0) RC(3,1) RC(3,2) RC(3,5)   RC(7,5) RC(7,2) RC(7,1) RC(7,0)
    >;
};
